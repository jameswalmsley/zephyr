## prj.conf
```kconfig
CONFIG_GPIO=y
CONFIG_PM=n
CONFIG_PM_DEVICE=n
CONFIG_TICKLESS_KERNEL=n
CONFIG_ASSERT=y
CONFIG_FAULT_DUMP=2

CONFIG_INIT_STACKS=y
CONFIG_STACK_SENTINEL=y
CONFIG_THREAD_STACK_INFO=y

CONFIG_DEBUG=y
CONFIG_LOG=y
```

## src/main.c
```c
/*
 * Copyright (c) 2016 Intel Corporation
 *
 * SPDX-License-Identifier: Apache-2.0
 */

#include <stdio.h>
#include <zephyr/kernel.h>
#include <zephyr/drivers/gpio.h>

/* 1000 msec = 1 sec */
#define SLEEP_TIME_MS   1000

/* The devicetree node identifier for the "led0" alias. */
#define LED0_NODE DT_ALIAS(led0)

/*
 * A build error on this line means your board is unsupported.
 * See the sample documentation for information on how to fix this.
 */
static const struct gpio_dt_spec led = GPIO_DT_SPEC_GET(LED0_NODE, gpios);
static const struct gpio_dt_spec led2 = GPIO_DT_SPEC_GET(DT_ALIAS(led1), gpios);

int main(void)
{
	int ret;
	bool led_state = true;

	// if (!gpio_is_ready_dt(&led)) {
	// 	return 0;
	// }

	ret = gpio_pin_configure_dt(&led, GPIO_OUTPUT_ACTIVE);
	if (ret < 0) {
		//return 0;
	}

	int i = 0;

	while (1) {
		printk("Toggling the leds\n");
		ret = gpio_pin_toggle_dt(&led);
		if (ret < 0) {
			return 0;
		}

		i++;

		if(i > 2) {
			gpio_pin_toggle_dt(&led2);
		}

		led_state = !led_state;
		printf("LED state: %s\n", led_state ? "ON" : "OFF");
		k_msleep(SLEEP_TIME_MS);
	}
	return 0;
}
```
