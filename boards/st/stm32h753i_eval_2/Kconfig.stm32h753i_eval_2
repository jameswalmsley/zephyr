## boards/st/stm32h753i_eval_2/Kconfig.stm32h753i_eval_2
```kconfig
# STM32H753I EVAL 2 board configuration

# Copyright (c) 2026 James Walmsley <james@fullfat-fs.co.uk>
# SPDX-License-Identifier: Apache-2.0

config BOARD_STM32H753I_EVAL_2
	select SOC_STM32H743XX
```

## boards/st/stm32h753i_eval_2/board.yml
```yaml
board:
  name: stm32h753i_eval_2
  full_name: STM32H753I Eval 2
  vendor: st
  socs:
    - name: stm32h743xx
```

## drivers/otp/Kconfig.stm32
```kconfig
# Copyright (c) 2026 STMicroelectronics
# SPDX-License-Identifier: Apache-2.0

config OTP_STM32_BSEC
	bool "STM32 BSEC driver"
	default y
	select USE_STM32_HAL_BSEC
	depends on DT_HAS_ST_STM32_BSEC_ENABLED
	help
	  Enable OTP fuse access for STM32 SoCs embedding a BSEC peripheral.

config OTP_STM32_NVM
	bool "STM32 embedded NVM OTP driver"
	default y
	depends on DT_HAS_ST_STM32_NVM_OTP_ENABLED
	help
	  Enable driver for OTP regions inside embedded non-volatile memory
	  found in STM32 SoCs.

	  N.B.: the "program" operation is currently not supported.

config OTP_STM32
	bool "STM32 Flash OTP driver"
	default y
	depends on DT_HAS_ST_STM32_OTP_ENABLED
	depends on SOC_FLASH_STM32
	help
	  Enable access to STM32 embedded Flash OTP memory.
	  OTP programming uses the STM32 flash driver infrastructure.
```
